## examples/nxp/runtime/imxrt700/Kconfig
```kconfig
menu "ExecuTorch"
    config MCUX_COMPONENT_middleware.eiq.executorch
        bool "Enable ExecuTorch"
    config MCUX_COMPONENT_middleware.eiq.executorch.binary
        bool "Use Executorch Binary"
        select MCUX_COMPONENT_middleware.eiq.executorch
    config MCUX_COMPONENT_middleware.eiq.executorch.neutron
        bool "Enable Neutron"
        select MCUX_COMPONENT_middleware.eiq.executorch
    config MCUX_COMPONENT_middleware.eiq.executorch.source
        bool "Use ExecuTorch Source"
        select MCUX_COMPONENT_middleware.eiq.executorch
endmenu
```
